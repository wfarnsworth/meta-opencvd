## conf/layer.conf
```bitbake
BBPATH .= ":${LAYERDIR}"
BBFILES += "${LAYERDIR}/recipes/*/*.bb \
            ${LAYERDIR}/recipes/*/*.bbappend \
            ${LAYERDIR}/recipes-*/*/*.bb \
            ${LAYERDIR}/recipes-*/*/*.bbappend"
BBFILE_COLLECTIONS += "opencv"
BBFILE_PRIORITY_opencv = "10"
BBFILE_PATTERN_opencv = "^${LAYERDIR}/"

BB_DANGLINGAPPENDS_WARNONLY = "1"
```
